## Yocto/Creating_Layer/meta-AliLayer/conf/layer.conf
```bitbake
# We have a conf and classes directory, add to BBPATH
BBPATH .= ":${LAYERDIR}"

# We have recipes-* directories, add to BBFILES
BBFILES += "${LAYERDIR}/recipes-*/*/*.bb \
            ${LAYERDIR}/recipes-*/*/*.bbappend"

BBFILE_COLLECTIONS += "meta-AliLayer"
BBFILE_PATTERN_meta-AliLayer = "^${LAYERDIR}/"
BBFILE_PRIORITY_meta-AliLayer = "6"

LAYERDEPENDS_meta-AliLayer = "core"
LAYERSERIES_COMPAT_meta-AliLayer = "scarthgap"
```
